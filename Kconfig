## Kconfig
```kconfig
DT_COMPAT_ZMK_BEHAVIOR_CASE_MODE := zmk,behavior-case-mode

config ZMK_BEHAVIOR_CASE_MODE
	bool
	default $(dt_compat_enabled,$(DT_COMPAT_ZMK_BEHAVIOR_CASE_MODE))
```

## config/west.yml
```yaml
manifest:
  remotes:
    # zmk official
    - name: zmkfirmware
      url-base: https://github.com/zmkfirmware
    # Urchin keeb
    - name: duckyb
      url-base: https://github.com/duckyb
    # Forager keeb
    - name: carrefinho
      url-base: https://github.com/carrefinho
    # Extra module for battery indicator
    - name: caksoylar
      url-base: https://github.com/caksoylar
    # Case mode behavior module
    - name: msmaili
      url-base: https://github.com/MSmaili
  projects:
    - name: zmk
      remote: zmkfirmware
      revision: main
      import: app/west.yml
    - name: urchin-zmk-module
      remote: duckyb
      revision: main
    - name: forager-zmk-module
      remote: carrefinho
      revision: main
    - name: zmk-rgbled-widget
      remote: caksoylar
      revision: main
    - name: zmk-case-mode
      remote: msmaili
      revision: main
  self:
    path: config
```

## dts/bindings/behaviors/zmk,behavior-case-mode.yaml
```yaml
# Copyright (c) 2024 The ZMK Contributors
# SPDX-License-Identifier: MIT

description: |
  Case mode behavior. Intercepts space and replaces it with a delimiter
  depending on the mode: underscore (snake_case), suppress+shift (camelCase),
  or hyphen (kebab-case).

compatible: "zmk,behavior-case-mode"
include: zero_param.yaml

properties:
  continue-list:
    type: array
    required: false
    description: |
      List of extra keycodes which do not deactivate case mode.
      Alphanumeric characters are always included.
  mode:
    type: int
    required: true
    description: |
      The case mode type. 0 = snake, 1 = camel, 2 = kebab.
```
